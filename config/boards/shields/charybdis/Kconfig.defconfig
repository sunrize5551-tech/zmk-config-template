## config/boards/shields/charybdis/Kconfig.defconfig
```kconfig
if SHIELD_CHARYBDIS_LEFT
config ZMK_KEYBOARD_NAME
    default "Charybdis Left"
endif

if SHIELD_CHARYBDIS_RIGHT
config ZMK_KEYBOARD_NAME
    default "Charybdis Right"
endif
```
